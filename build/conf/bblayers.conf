## build/conf/bblayers.conf
```bitbake
# POKY_BBLAYERS_CONF_VERSION is increased each time build/conf/bblayers.conf
# changes incompatibly
POKY_BBLAYERS_CONF_VERSION = "2"

BBPATH = "${TOPDIR}"
BBFILES ?= ""

BBLAYERS ?= " \
  /mnt/knowledge/Knowledge-OS/poky/meta \
  /mnt/knowledge/Knowledge-OS/meta-openembedded/meta-oe \
  /mnt/knowledge/Knowledge-OS/meta-openembedded/meta-python \
  /mnt/knowledge/Knowledge-OS/meta-openembedded/meta-multimedia \
  /mnt/knowledge/Knowledge-OS/meta-openembedded/meta-networking \
  /mnt/knowledge/Knowledge-OS/meta-openembedded/meta-filesystems \
  /mnt/knowledge/Knowledge-OS/meta-arm/meta-arm-toolchain \
  /mnt/knowledge/Knowledge-OS/meta-arm/meta-arm \
  /mnt/knowledge/Knowledge-OS/meta-tensorflow \
  /mnt/knowledge/Knowledge-OS/meta-kos-core \
  /mnt/knowledge/Knowledge-OS/meta-ros/meta-ros-common \
  /mnt/knowledge/Knowledge-OS/meta-ros/meta-ros2 \
  /mnt/knowledge/Knowledge-OS/meta-ros/meta-ros2-humble \
  /mnt/knowledge/Knowledge-OS/meta-onnxruntime \
  /mnt/knowledge/Knowledge-OS/meta-raspberrypi \
  /mnt/knowledge/Knowledge-OS/meta-mender/meta-mender-core \
  /mnt/knowledge/Knowledge-OS/meta-mender-community/meta-mender-raspberrypi \
  /mnt/knowledge/Knowledge-OS/meta-mender/meta-mender-demo \
  "
```

## build/conf/local.conf
```bitbake
# Local configuration file for MerlinOS Build

# Machine Selection
MACHINE ??= "qemux86-64"
DISTRO ?= "MerlinOS"

BBMULTICONFIG = "qemuarm64 qemux86-64 raspberrypi"

# Disk Space Monitoring during the build
BB_DISKMON_DIRS ??= "\
    STOPTASKS,${TMPDIR},1G,100K \
    STOPTASKS,${DL_DIR},1G,100K \
    STOPTASKS,${SSTATE_DIR},1G,100K \
    STOPTASKS,/tmp,100M,100K \
    HALT,${TMPDIR},100M,1K \
    HALT,${DL_DIR},100M,1K \
    HALT,${SSTATE_DIR},100M,1K \
    HALT,/tmp,10M,1K"

# Packaging
USER_CLASSES ?= "buildstats"

# Interactive shell
PATCHRESOLVE = "noop"

# Qemu configuration
PACKAGECONFIG:append:pn-qemu-system-native = " sdl"

CONF_VERSION = "2"

# Limit build to 6 CPU cores
BB_NUMBER_THREADS ?= "6"
PARALLEL_MAKE ?= "-j 6"
```

## meta-knowledgeos-ai/conf/layer.conf
```bitbake
# We have a conf and classes directory, add to BBPATH
BBPATH .= ":${LAYERDIR}"

# We have recipes-* directories, add to BBFILES
BBFILES += "${LAYERDIR}/recipes-*/*/*.bb \
            ${LAYERDIR}/recipes-*/*/*.bbappend"

BBFILE_COLLECTIONS += "meta-knowledgeos-ai"
BBFILE_PATTERN_meta-knowledgeos-ai = "^${LAYERDIR}/"
BBFILE_PRIORITY_meta-knowledgeos-ai = "6"

LAYERDEPENDS_meta-knowledgeos-ai = "core"
LAYERSERIES_COMPAT_meta-knowledgeos-ai = "scarthgap"
```

## meta-kos-core/conf/distro/MerlinOS.conf
```bitbake
# =========================================================================
# MerlinOS Distribution Configuration
# =========================================================================

# --- Distribution Identity ---
DISTRO = "MerlinOS"
DISTRO_NAME = "MerlinOS"
DISTRO_VERSION = "1.0"
DISTRO_CODENAME = "horizon"

# --- Branding and Appearance ---
BASEFS_IMAGE_BANNER = "MerlinOS 1.0 \\n \\l"
hostname:pn-base-files = "merlinos"

# --- System Management & Initialization ---
INIT_MANAGER = "systemd"

DISTRO_FEATURES:append = " systemd pam read-only-rootfs"
DISTRO_FEATURES:remove = "sysvinit x11 wayland vulkan alsa bluetooth nfc 3g pci opengl"

VIRTUAL-RUNTIME_init_manager = "systemd"
VIRTUAL-RUNTIME_initscripts = "systemd-compat-units"
VIRTUAL-RUNTIME_login_manager = "systemd"
DISTRO_FEATURES_BACKFILL_CONSIDERED:append = " sysvinit"
EXTRA_IMAGE_FEATURES += "debug-tweaks"

# Enable Read-Only Root Filesystem globally for all MerlinOS builds
IMAGE_FEATURES += "read-only-rootfs"

# --- Image Optimizations ---
ENABLE_BINARY_LOCALE_GENERATION = "1"
GLIBC_GENERATE_LOCALES = "en_US.UTF-8"
IMAGE_LINGUAS = "en-us"
LOCALE_UTF8_ONLY = "1"

# Map /var/volatile to RAM (tmpfs)
VOLATILE_LOG_DIR = "yes"

# Kernel
PREFERRED_PROVIDER_virtual/kernel = "linux-yocto-rt"
KERNEL_VERSION_SANITY_SKIP = "1"

# Read-Only Root Filesystem prep
FORCE_RO_REMOVE_ROOTFS = "1"

BAD_RECOMMENDATIONS += "python3-modules"

# File System Padding
# IMAGE_ROOTFS_EXTRA_SPACE = "4194304"

# --- Performance & Build Tuning ---
BB_NUMBER_THREADS = "6"
PARALLEL_MAKE = "-j 6"
BAZEL_JOBS = "2"
BAZEL_MEM = "8000"

# --- Development & Licensing ---
INHERIT += "uninative rm_work"
require conf/distro/include/yocto-uninative.inc

LICENSE_FLAGS_ACCEPTED += "commercial"
LICENSE_FLAGS_ACCEPTED:append = " synaptics-killswitch"

# --- Initramfs Configuration ---
INITRAMFS_IMAGE = "core-image-minimal-initramfs"
INITRAMFS_IMAGE_BUNDLE = "1"
```

## meta-kos-core/conf/distro/knowledgeos.conf
```bitbake
# meta-kos-core/conf/distro/knowledgeos.conf
DISTRO = "knowledgeos"
DISTRO_NAME = "KnowledgeOS"
DISTRO_VERSION = "1.0"
DISTRO_CODENAME = "horizon"

# Branding
BASEFS_IMAGE_BANNER = "KnowledgeOS 1.0 \\n \\l"
hostname_pn-base-files = "knowledgeos"

# # System Management
# INIT_MANAGER = "systemd"
# DISTRO_FEATURES:append = " systemd pam opengl virtualization"
# DISTRO_FEATURES_BACKFILL_CONSIDERED += "sysvinit"
# VIRTUAL-RUNTIME_init_manager = "systemd"
# VIRTUAL-RUNTIME_initscripts = "systemd-compat-units"

# # Remove unnecessary features
# DISTRO_FEATURES:remove = "x11 wayland vulkan alsa bluetooth nfc 3g pci"

# 1. Disable systemd and use sysvinit (which BusyBox uses)
# DISTRO_FEATURES:append = " sysvinit"
# DISTRO_FEATURES:remove = "systemd"
# VIRTUAL-RUNTIME_init_manager = "busybox"
# VIRTUAL-RUNTIME_initscripts = "initscripts"
# VIRTUAL-RUNTIME_login_manager = "busybox"

# # Remove systemd, opengl, and virtualization from features
# # These were pulling in mesa, python3, and heavy libraries
# DISTRO_FEATURES:append = " tiny ipv4 ipv6"
# DISTRO_FEATURES:remove = "systemd pam opengl virtualization x11 wayland vulkan alsa bluetooth nfc 3g pci"

# # Optimization for the final binary images
# IMAGE_LINGUAS = "" 
# FORCE_RO_REMOVE_ROOTFS = "1"
# # Prevents 'recommended' bloat from being installed
# BAD_RECOMMENDATIONS += "systemd python3 python3-modules"

# # Enable uninative to support pre-compiled tools like Bazel
# INHERIT += "uninative"

# # Development & Licensing
# LICENSE_FLAGS_ACCEPTED += "commercial"


# --- System Management: Systemd ---
# This single line handles most of the heavy lifting in modern Yocto
INIT_MANAGER = "systemd"

# Ensure systemd is active and remove sysvinit to avoid conflicts
DISTRO_FEATURES:append = " systemd pam"
DISTRO_FEATURES:remove = "sysvinit"

# Point runtime providers to systemd
VIRTUAL-RUNTIME_init_manager = "systemd"
VIRTUAL-RUNTIME_initscripts = "systemd-compat-units"
VIRTUAL-RUNTIME_login_manager = "systemd"

# Prevent sysvinit scripts from being backfilled into the image
DISTRO_FEATURES_BACKFILL_CONSIDERED:append = " sysvinit"

# --- Hardware & Features ---
# Keep it lean: we still don't need GUIs or heavy desktop protocols for a drone
DISTRO_FEATURES:append = " tiny ipv4 ipv6 virtualization"
DISTRO_FEATURES:remove = "x11 wayland vulkan alsa bluetooth nfc 3g pci opengl"

# --- Optimization ---
IMAGE_LINGUAS = "" 
FORCE_RO_REMOVE_ROOTFS = "1"

# We allow python3 now since you need it for AI/MAVLink, but keep it minimal
# Removed "systemd" from BAD_RECOMMENDATIONS
BAD_RECOMMENDATIONS += "python3-modules"

# --- Development & Licensing ---
INHERIT += "uninative"
LICENSE_FLAGS_ACCEPTED += "commercial"
```

## meta-kos-core/conf/layer.conf
```bitbake
# =========================================================================
# MerlinOS Core Layer Configuration (meta-kos-core)
# =========================================================================
#
# This file configures the core Yocto layer for MerlinOS. A "layer" in Yocto
# is a repository containing related sets of instructions (recipes) that tell
# the build system how to build software, configure images, or define
# specific machine behaviors.
#
# This specific layer (meta-kos-core) houses the foundational recipes,
# system configurations, and the distro definition for MerlinOS.
# =========================================================================


# --- Include Paths Setting ---
# We add the directory containing this layer (and its subdirectories like
# 'conf' and 'classes') to BBPATH. This allows the BitBake build engine to
# locate configuration files (like our distro config) and custom classes
# defined within this layer.
BBPATH .= ":${LAYERDIR}"


# --- Recipe Location Definition ---
# This tells BitBake where to find the actual software build instructions
# (.bb files) and recipe modifications (.bbappend files). We use wildcards
# to automatically include any recipe files located within the 'recipes-*'
# subdirectories of this layer.
BBFILES += "${LAYERDIR}/recipes-*/*/*.bb \
            ${LAYERDIR}/recipes-*/*/*.bbappend"


# --- Layer Identification and Priority ---
# BBFILE_COLLECTIONS: Registers a unique name for this layer within the
# build environment. We register it as "meta-kos-core".
BBFILE_COLLECTIONS += "meta-kos-core"

# BBFILE_PATTERN: BitBake uses this regular expression to identify which
# files belong to this layer. It matches anything under the current layer's
# root directory (${LAYERDIR}).
BBFILE_PATTERN_meta-kos-core = "^${LAYERDIR}/"

# BBFILE_PRIORITY: Sets the priority of this layer. If multiple layers
# provide a recipe with the same name and version, BitBake chooses the one
# from the layer with the highest priority. A priority of "15" is relatively
# high, meaning this core layer's recipes will generally override default
# upstream recipes if they conflict.
BBFILE_PRIORITY_meta-kos-core = "15"


# --- Layer Dependencies and Compatibility ---
# LAYERDEPENDS: Lists the other Yocto layers that this layer relies on to
# function properly. Our core layer depends on the foundational OpenEmbedded
# "core" layer (meta).
LAYERDEPENDS_meta-kos-core = "core"

# LAYERSERIES_COMPAT: Declares which versions (release series) of the Yocto
# Project this layer is compatible with. "scarthgap" refers to the specific
# Yocto release (version 5.0). BitBake will refuse to parse this layer if
# the environment is not based on a compatible series.
LAYERSERIES_COMPAT_meta-kos-core = "scarthgap"
```

## meta-kos-core/wic/merlin-drone.wks
```
# short-description: Create MerlinOS SD card image for Drone
# long-description: Creates a partitioned SD card image with a read-only rootfs and writable data partition.

part /boot --source bootimg-partition --ondisk mmcblk0 --fstype=vfat --label boot --active --align 4096 --size 100
part / --source rootfs --ondisk mmcblk0 --fstype=ext4 --label root --align 4096
part /data --ondisk mmcblk0 --fstype=ext4 --label data --align 4096 --size 1024
```
